## sdkconfig.defaults
```kconfig
CONFIG_HTTPD_WS_SUPPORT=y
CONFIG_PARTITION_TABLE_CUSTOM=y
CONFIG_PARTITION_TABLE_CUSTOM_FILENAME="esp32c6-bridge/partitions.csv"
CONFIG_SPIFFS_OBJ_NAME_LEN=64
CONFIG_SPIFFS_USE_MTIME=y
CONFIG_ESPTOOLPY_FLASHSIZE_4MB=y
```
